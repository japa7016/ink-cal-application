/dts-v1/;
/plugin/;

/ {
    compatible = "brcm,bcm2711";

    fragment@0 {
        target = <&spi0>;
        __overlay__ {
            status = "okay";

            #address-cells = <1>;
            #size-cells    = <0>;

            epd@0 {
                compatible         = "waveshare,epd";
                reg                = <0>;            
                spi-max-frequency  = <2000000>;
                reset-gpios        = <&gpio 17 0>;
                dc-gpios           = <&gpio 27 0>;
                busy-gpios         = <&gpio 22 0>;
            };
        };
    };
};

